## firmware/zmk/philoctetes/Kconfig.defconfig
```kconfig
if SHIELD_PHILOCTETES_LEFT

# Name must be less than 16 characters long!
config ZMK_KEYBOARD_NAME
    default "Philoctetes"

config ZMK_SPLIT_ROLE_CENTRAL
    default y

endif

if SHIELD_PHILOCTETES_LEFT || SHIELD_PHILOCTETES_RIGHT

config ZMK_SPLIT
    default y

endif
```

## firmware/zmk/philoctetes/Kconfig.shield
```kconfig
# Copyright (c) 2020 Justin Russell
# SPDX-License-Identifier: MIT

config SHIELD_PHILOCTETES_LEFT
    def_bool $(shields_list_contains,philoctetes_left)

config SHIELD_PHILOCTETES_RIGHT
    def_bool $(shields_list_contains,philoctetes_right)
```
